## arch/arm/mach-rockchip/rk3576/Kconfig
```kconfig
if ROCKCHIP_RK3576

config TARGET_KICKPI_K7_RK3576
	bool "KICKPI K7 N-Boot downstream"
	select LINUX_KERNEL_IMAGE_HEADER
	help
	  Enable the KICKPI K7 N-Boot board contract, including the native
	  ARM64 Image header required by the vendor BL31 boot chain.

config NBOOT_FASTBOOT
	bool "N-Boot controlled USB recovery"
	depends on TARGET_KICKPI_K7_RK3576 && USB_GADGET
	select USB_FUNCTION_FASTBOOT
	select FASTBOOT_OEM_BOARD
	help
	  Enable verified NuttX A/B and N-Boot updates. Generic
	  partition writes require a short-lived two-command confirmation.
	  Erase and arbitrary command execution stay disabled.

config TARGET_ROC_PC_RK3576
	bool "Firefly ROC-RK3576-PC"
	help
	  ROC-RK3576-PC is a single board computer from Firefly
	  using the Rockchip RK3576.

config ROCKCHIP_BOOT_MODE_REG
	default 0x26024040

config ROCKCHIP_STIMER_BASE
	default 0x27400000

config SYS_SOC
	default "rk3576"

source board/firefly/roc-pc-rk3576/Kconfig

config SYS_CONFIG_NAME
	default "rk3576_common"

endif
```

## configs/kickpi-k7-rk3576-full_defconfig
```kconfig
CONFIG_ARM=y
CONFIG_SKIP_LOWLEVEL_INIT=y
CONFIG_COUNTER_FREQUENCY=24000000
CONFIG_ARCH_ROCKCHIP=y
CONFIG_SPL_GPIO=y
CONFIG_DEFAULT_DEVICE_TREE="rk3576-kickpi-k7"
CONFIG_ROCKCHIP_RK3576=y
CONFIG_TARGET_KICKPI_K7_RK3576=y
CONFIG_TEXT_BASE=0x40200000
CONFIG_SYS_LOAD_ADDR=0x40c00800
CONFIG_DEBUG_UART_BASE=0x2AD40000
CONFIG_DEBUG_UART_CLOCK=24000000
CONFIG_PCI=y
CONFIG_DEBUG_UART=y
CONFIG_SYS_PROMPT="N-Boot> "
CONFIG_IDENT_STRING=" / N-Boot"
CONFIG_BOOTDELAY=5
CONFIG_BOOTCOMMAND="bootnuttx 0"
CONFIG_DEFAULT_FDT_FILE="rockchip/rk3576-kickpi-k7.dtb"
# CONFIG_DISPLAY_CPUINFO is not set
# CONFIG_BOOTMETH_VBE is not set
CONFIG_SPL_MAX_SIZE=0x40000
# CONFIG_SPL_RAW_IMAGE_SUPPORT is not set
CONFIG_CMD_MEMINFO=y
CONFIG_CMD_MEMINFO_MAP=y
CONFIG_CMD_ADC=y
CONFIG_CMD_GPIO=y
CONFIG_CMD_GPT=y
CONFIG_CMD_I2C=y
CONFIG_CMD_MISC=y
CONFIG_CMD_MMC=y
CONFIG_CMD_PCI=y
CONFIG_CMD_USB=y
CONFIG_CMD_ROCKUSB=y
CONFIG_CMD_USB_MASS_STORAGE=y
CONFIG_CMD_RNG=y
CONFIG_CMD_REGULATOR=y
CONFIG_CMD_HASH=y
CONFIG_CMD_CRC32=y
CONFIG_CMD_PART=y
CONFIG_CMD_BOOTNUTTX=y
CONFIG_CMD_EXT4=y
CONFIG_CMD_EXT4_WRITE=y
CONFIG_CMD_FAT=y
CONFIG_CMD_FS_GENERIC=y
CONFIG_CMD_EROFS=y
CONFIG_CMD_SQUASHFS=y
CONFIG_CMD_UNZIP=y
CONFIG_CMD_UNLZ4=y
CONFIG_CMD_LZMADEC=y
CONFIG_CMD_LOADB=y
CONFIG_CMD_LOADS=y
CONFIG_CMD_DHCP=y
CONFIG_CMD_PING=y
CONFIG_CMD_TFTPBOOT=y
CONFIG_CMD_TFTPPUT=y
CONFIG_CMD_CACHE=y
CONFIG_HASH=y
CONFIG_SHA256=y
CONFIG_PARTITION_UUIDS=y
# CONFIG_OF_UPSTREAM is not set
CONFIG_OF_SPL_REMOVE_PROPS="clock-names interrupt-parent assigned-clocks assigned-clock-rates assigned-clock-parents"
CONFIG_ROCKCHIP_GPIO=y
CONFIG_SYS_I2C_ROCKCHIP=y
CONFIG_SUPPORT_EMMC_RPMB=y
CONFIG_MMC_DW=y
CONFIG_MMC_DW_ROCKCHIP=y
CONFIG_MMC_SDHCI=y
CONFIG_MMC_SDHCI_SDMA=y
CONFIG_MMC_SDHCI_ROCKCHIP=y
CONFIG_DWC_ETH_QOS=y
CONFIG_DWC_ETH_QOS_ROCKCHIP=y
CONFIG_PHY_REALTEK=y
CONFIG_NVME_PCI=y
CONFIG_PCIE_DW_ROCKCHIP=y
CONFIG_PHY_ROCKCHIP_INNO_USB2=y
CONFIG_PHY_ROCKCHIP_NANENG_COMBOPHY=y
CONFIG_PHY_ROCKCHIP_USBDP=y
CONFIG_DM_PMIC=y
CONFIG_PMIC_RK8XX=y
CONFIG_REGULATOR_RK8XX=y
CONFIG_SCSI=y
CONFIG_BAUDRATE=1500000
CONFIG_DEBUG_UART_SHIFT=2
CONFIG_SYS_NS16550_MEM32=y
CONFIG_SYSRESET_PSCI=y
CONFIG_USB=y
CONFIG_USB_XHCI_HCD=y
CONFIG_USB_DWC3=y
CONFIG_USB_DWC3_GENERIC=y
CONFIG_USB_STORAGE=y
CONFIG_USB_GADGET=y
CONFIG_USB_GADGET_DOWNLOAD=y
CONFIG_USB_FUNCTION_ROCKUSB=y
# CONFIG_USB_FUNCTION_FASTBOOT is not set
CONFIG_ERRNO_STR=y
```
